// RFID Config
  #include <Wire.h>
  #include <PN532_I2C.h>
  #include <PN532.h>

  PN532_I2C pn532i2c(Wire);
  PN532 nfc(pn532i2c);

//Display SSD1306
  #include <Adafruit_GFX.h>
  #include <Adafruit_SSD1306.h>
  
  #define OLED_RESET 4
  Adafruit_SSD1306 display(OLED_RESET);
  
  #define NUMFLAKES 10
  #define XPOS 0
  #define YPOS 1
  #define DELTAY 2
  #define LOGO16_GLCD_HEIGHT 16 
  #define LOGO16_GLCD_WIDTH  16 

  const unsigned char myBitmap [] PROGMEM = {
    0x00, 0x00, 0x00, 0x00, 0x00, 0x00, 0x3f, 0x00, 0x03, 0xe0, 0x00, 0x00, 0x00, 0x00, 0x00, 0x00, 
    0x00, 0x00, 0x00, 0x00, 0x00, 0x00, 0x3f, 0xe0, 0x1f, 0xe0, 0x00, 0x00, 0x00, 0x00, 0x00, 0x00, 
    0x00, 0x00, 0x00, 0x00, 0x00, 0x00, 0x3f, 0xf0, 0x3f, 0xe0, 0x00, 0x00, 0x00, 0x00, 0x00, 0x00, 
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    0x00, 0x00, 0x00, 0x00, 0x00, 0x00, 0x00, 0x00, 0x00, 0x00, 0x00, 0x00, 0x00, 0x00, 0x00, 0x00
  };

// Definizione variabili
  int ledPin = 3;
  int buzPin = 4;
  String UIDrequest = "";
  String UIDassist = "";

void setup(void) {
  pinMode(ledPin, OUTPUT);
  digitalWrite(ledPin, HIGH);
  pinMode(buzPin, OUTPUT);
  tone(buzPin,1000,200);
  delay(2000);
  digitalWrite(ledPin, LOW);
  
  Serial.begin(9600);
  Serial.println("Serial OK!");

  display.begin(SSD1306_SWITCHCAPVCC, 0x3C);  // initialize with the I2C addr 0x3D (for the 128x64)
  Serial.println("Display OK!");
  display.clearDisplay();
  display.drawBitmap(0, 0, myBitmap, 128, 32, WHITE);
  display.display();
  delay(3000);
  
  nfc.begin();
  Serial.println("NFC OK!");

  uint32_t versiondata = nfc.getFirmwareVersion();
  if (! versiondata) {
    Serial.print("Didn't find PN53x board");
    while (1); // halt
  }
  // Got ok data, print it out!
  Serial.print("Found chip PN5"); Serial.println((versiondata>>24) & 0xFF, HEX); 
  Serial.print("Firmware ver. "); Serial.print((versiondata>>16) & 0xFF, DEC); 
  Serial.print('.'); Serial.println((versiondata>>8) & 0xFF, DEC);
  
  // configure board to read RFID tags
  nfc.SAMConfig();
  
  Serial.println("Waiting for an ISO14443A Card ...");
}

void loop(void) {
  display.clearDisplay();
  display.setTextColor(WHITE);
  display.clearDisplay();
  display.setTextSize(1);
  display.setCursor(1, 1);
  display.print("Attesa CARD!");
  display.display();
  String codiceLetto ="";
  String UIDB="";
  byte i;
  uint8_t success;
  uint8_t uid[] = { 0, 0, 0, 0, 0, 0, 0 };  // Buffer to store the returned UID
  uint8_t uidLength;                        // Length of the UID (4 or 7 bytes depending on ISO14443A card type)
    
  success = nfc.readPassiveTargetID(PN532_MIFARE_ISO14443A, uid, &uidLength);
  if (success==0) {
    delay(50);
    return;
  }  

  Serial.print("Found a card! ");
  for (byte i = 0; i < uidLength; i++) 
    {
      UIDB=String (uid[i],HEX);
      if (UIDB.length()==1) {
        UIDB= "0" + UIDB;
      }
      codiceLetto+= UIDB;
      codiceLetto.toUpperCase();
    }  
  Serial.println(codiceLetto);
  
  if (codiceLetto != UIDrequest) {
    UIDrequest = codiceLetto;
    if (digitalRead(ledPin) == 0) {
      Serial.print("Richiesta intervento da: ");
      display.clearDisplay();
      display.setTextSize(1);
      display.setCursor(1, 1);
      display.print("Richiesta intervento");
      display.setTextSize(2);
      display.setCursor(1, 11);
      display.print(codiceLetto);
      display.display();
      digitalWrite(ledPin, HIGH);
      tone(buzPin,1000,500);}
    else {
      digitalWrite(ledPin, LOW);
      Serial.print("Intervento eseguito da:");
      UIDrequest = "";
      display.clearDisplay();
      display.setTextSize(1);
      display.setCursor(1, 1);
      display.print("Esecuzione intervento:");
      display.setTextSize(2);
      display.setCursor(1, 11);
      display.print(codiceLetto);
      display.display();
      tone(buzPin,1000,500);}
      Serial.println(codiceLetto);}
  else {
    tone(buzPin,500,500);}
  delay(5000);
}  
